/**
  *****************************************************************************
  * @title        BasicDisplay.c
  * @Description  Show how a minimal display on a monochrome LCD Nokia 5110.
  *				  The code display a black and white bitmap (3 bitmaps or message )
  * 		      The User Leds are connected to the  GPIO port C, from pin 8 up to 15.
  *
  * Connection with the STM32F103C8T6:
  *                  STM32			Nokia 5110
  *				    -------------------------------
  *   				  A12 	 -->    LCD_PIN_ENABLE
  *   				  A11 	 -->    LCD_PIN_RESET
  *   				  A10 	 -->    LCD_PIN_COMMAND
  *   				  A9	 -->    LCD_PIN_DATA
  *   				  A8	 -->    LCD_PIN_CLOCK
  *					 GND     -->    LCD_LIGHT
  *
  *		Note: Put the LCD_LIGHT to the ground to make it light up permenantly...
  *
  ********************************************************************************/

  #include "stm32f10x.h"
  #include "stm32f10x_rcc.h"
  #include "stm32f10x_gpio.h"

  //#include "STM32vldiscovery.h"

  #define LCD_PIN_ENABLE      GPIO_Pin_12
  #define LCD_PIN_RESET       GPIO_Pin_11
  #define LCD_PIN_COMMAND     GPIO_Pin_10
  #define LCD_PIN_DATA        GPIO_Pin_9
  #define LCD_PIN_CLOCK       GPIO_Pin_8

  #define LCD_CMD             0
  #define LCD_DATA            1

  GPIO_InitTypeDef GPIO_InitStructure;
  uint8_t messageBytes[] = {
  	0x3e, 0x41, 0x41, 0x41, 0x22, 0x00, 0x38, 0x44, 0x44, 0x44, 0x38, 0x00, 0x7c, 0x08, 0x04, 0x04, 0x08, 0x00,
  	0x04, 0x3f, 0x44, 0x40, 0x20, 0x00, 0x38, 0x54, 0x54, 0x54, 0x18, 0x00, 0x44, 0x28, 0x10, 0x28, 0x44, 0x00,
  	0x00, 0x00, 0x00, 0x00, 0x00, 0x00, 0x7f, 0x02, 0x0c, 0x02, 0x7f, 0x00, 0x21, 0x41, 0x45, 0x4b, 0x31, 0x00,
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  	0x7c, 0x08, 0x04, 0x04, 0x08, 0x00, 0x0c, 0x50, 0x50, 0x50, 0x3c, 0x00
  };


  uint8_t graphic [] = {
  	0x00, 0x00, 0x00, 0x00, 0x00, 0x00, 0x00, 0x00, 0x00, 0x00, 0x00, 0x00, 0x00, 0x00, 0x00, 0x00,
  	0x00, 0x00, 0x00, 0x00, 0x00, 0x00, 0x00, 0x00, 0x00, 0x00, 0x00, 0x00, 0x00, 0x00, 0x80, 0x80,
  	0x80, 0x80, 0x80, 0x80, 0x80, 0x80, 0x80, 0x80, 0x80, 0x80, 0x80, 0x80, 0x80, 0x80, 0x80, 0x80,
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  	0x00, 0x00, 0x00, 0x00, 0x00, 0x00, 0x00, 0x00,
  };

  uint8_t mikro_bmp[] = {  //504
    0,   0,   0,  0,   0,   0,   0,   0,   0,   0,   0,   0,
    0, 255, 255,   0, 255, 255, 255,   7,  71,  99,  99,  99,
   99,  99,  99,  99, 103,   7, 143, 255, 255,  63,  63,  31,
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    0,   0,   0,   0,   0,   0,   0,   0,   0,   0,   0,   0
  };

  void LcdWrite(uint8_t dataOrCommand, uint8_t value);
  void LcdReset();
  void LcdInitalise();
  void delay_ms(__IO uint32_t nCount);


  void initPins()
  {
  		// Initialize PA8-PA12 as outputs
  		RCC_APB2PeriphClockCmd(RCC_APB2Periph_GPIOA, ENABLE);
  		GPIO_InitStructure.GPIO_Pin = LCD_PIN_ENABLE | LCD_PIN_RESET | LCD_PIN_COMMAND | LCD_PIN_DATA | LCD_PIN_CLOCK;
  		GPIO_InitStructure.GPIO_Mode = GPIO_Mode_Out_PP;
  		GPIO_InitStructure.GPIO_Speed = GPIO_Speed_10MHz;
  		GPIO_Init(GPIOA, &GPIO_InitStructure);
  }

  int main(void)
  {
  	initPins();

  	// Reset LCD & Initialise...
  	LcdReset();
  	LcdInitalise();

  	// Write the message
  	int i;
  	for (i=0; i<sizeof(mikro_bmp); i++)
  	  LcdWrite(LCD_DATA, mikro_bmp[i]);
  	//	for (i=0; i<sizeof(messageBytes); i++)
  	//	  LcdWrite(LCD_DATA, messageBytes[i]);

  	while (1){  }
  }

  void LcdWrite(uint8_t dataOrCommand, uint8_t value)
  {
  	if (dataOrCommand)
  		GPIO_SetBits(GPIOA, LCD_PIN_COMMAND);
  	else
  		GPIO_ResetBits(GPIOA, LCD_PIN_COMMAND);

  	GPIO_ResetBits(GPIOA, LCD_PIN_ENABLE);       // enable LCD

  	int i;
  	for (i = 0; i < 8; i++)
  	{
  		GPIO_ResetBits(GPIOA, LCD_PIN_CLOCK);
  		if (value & 0x80)
  			GPIO_SetBits(GPIOA, LCD_PIN_DATA);
  		else
  			GPIO_ResetBits(GPIOA, LCD_PIN_DATA);
  		value <<= 1;
  		GPIO_SetBits(GPIOA, LCD_PIN_CLOCK);      // LCD latches data on the rising clock edge
  	}

  	GPIO_SetBits(GPIOA, LCD_PIN_ENABLE);         // disable LCD
  }

  /*
   *   The LCD will reset by simpling setting the RST pin, wait (here 10 mSec, but some code take a shorter time)
   *   and bring the pin back to the ground...
   */

  void LcdReset()
  {
  	GPIO_SetBits(GPIOA, LCD_PIN_RESET);
  	delay_ms(10);
  	GPIO_ResetBits(GPIOA, LCD_PIN_RESET);
  	delay_ms(10);
  	GPIO_SetBits(GPIOA, LCD_PIN_RESET);
  }


  void LcdInitalise()
  {
  	// Initialize LCD state
  	LcdWrite(LCD_CMD, 0x21); // LCD Extended Commands.
  	LcdWrite(LCD_CMD, 0xB1); // Set LCD Vop (Contrast).
  	LcdWrite(LCD_CMD, 0x04); // Set Temp coefficent.
  	LcdWrite(LCD_CMD, 0x15); // LCD bias mode
  	LcdWrite(LCD_CMD, 0x20);
  	LcdWrite(LCD_CMD, 0x0C); // LCD in normal mode.
  }

  void delay_ms(__IO uint32_t nCount)
  {
  	uint32_t delay = nCount * 2516;              // approximate loops per ms at 24 MHz, Debug config
  	for(; delay != 0; delay--);
  }
